/*
 * ESP32 + SSD1306 OLED GIF player
 * Plays the 1-bit frames in frames.h (generated by gif2oled.py) on a 128x64 I2C OLED.
 */
#include <Wire.h>
#include <Adafruit_GFX.h>
#include <Adafruit_SSD1306.h>
#include "frames.h"

// ---- config (change if your wiring/address differ) ----
#define I2C_SDA   21
#define I2C_SCL   22
#define OLED_ADDR 0x3C          // most 0.96" SSD1306 modules; some are 0x3D

Adafruit_SSD1306 display(FRAME_W, FRAME_H, &Wire, -1);

void setup() {
  Wire.begin(I2C_SDA, I2C_SCL);
  Wire.setClock(800000);        // fast I2C for smooth animation; drop to 400000 if it glitches
  if (!display.begin(SSD1306_SWITCHCAPVCC, OLED_ADDR)) {
    for (;;) delay(1000);       // OLED not found - check wiring / I2C address
  }
  display.clearDisplay();
  display.display();
}

void loop() {
  for (int i = 0; i < FRAME_COUNT; i++) {
    display.clearDisplay();
    display.drawBitmap(0, 0, (const uint8_t*)pgm_read_ptr(&frames[i]),
                       FRAME_W, FRAME_H, SSD1306_WHITE);
    display.display();
    delay(FRAME_DELAY_MS);
  }
}
